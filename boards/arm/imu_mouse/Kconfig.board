## boards/arm/imu_mouse/Kconfig.board
```kconfig
# Copyright (c) 2024 Nordic Semiconductor ASA
# SPDX-License-Identifier: Apache-2.0

config BOARD_IMU_MOUSE
	bool "imu-mouse"
	depends on SOC_NRF52832_CIAA
```

## boards/arm/imu_mouse/Kconfig.defconfig
```kconfig
# Copyright (c) 2024 Nordic Semiconductor ASA
# SPDX-License-Identifier: Apache-2.0

if BOARD_IMU_MOUSE

config BOARD
	default "imu_mouse"

config BT_CTLR
   default BT


endif
```

## boards/arm/imu_mouse/imu_mouse_defconfig
```kconfig
# Copyright (c) 2024 Nordic Semiconductor ASA
# SPDX-License-Identifier: Apache-2.0

CONFIG_SOC_SERIES_NRF52X=y
CONFIG_SOC_NRF52832_CIAA=y
CONFIG_BOARD_IMU_MOUSE=y

# Disable MPU
CONFIG_ARM_MPU=n

# Enable hardware stack protection
CONFIG_HW_STACK_PROTECTION=y
```
